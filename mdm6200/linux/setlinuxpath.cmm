ENTRY &linux_path

Y.SPATH += &linux_path
Y.SPATH += &linux_path/mm
Y.SPATH += &linux_path/kernel
Y.SPATH += &linux_path/kernel/time
Y.SPATH += &linux_path/kernel/trace
Y.SPATH += &linux_path/kernel/debug
Y.SPATH += &linux_path/kernel/debug/kdb
Y.SPATH += &linux_path/kernel/power
Y.SPATH += &linux_path/kernel/gcov
Y.SPATH += &linux_path/kernel/irq
Y.SPATH += &linux_path/crypto
Y.SPATH += &linux_path/crypto/async_tx
Y.SPATH += &linux_path/arch
Y.SPATH += &linux_path/arch/l4
Y.SPATH += &linux_path/arch/l4/mm
Y.SPATH += &linux_path/arch/l4/sys-i386
Y.SPATH += &linux_path/arch/l4/kernel
Y.SPATH += &linux_path/arch/l4/drivers
Y.SPATH += &linux_path/arch/l4/include
Y.SPATH += &linux_path/arch/l4/include/asm
Y.SPATH += &linux_path/arch/l4/include/asm/arm
Y.SPATH += &linux_path/arch/l4/include/asm/arm/mach
Y.SPATH += &linux_path/arch/l4/include/asm/arm/arch-sa1100
Y.SPATH += &linux_path/arch/l4/include/asm/arm/arch-pxa
Y.SPATH += &linux_path/arch/l4/include/asm/arm/arch-msm
Y.SPATH += &linux_path/arch/l4/include/asm/arm/arch-msm/qdsp5
Y.SPATH += &linux_path/arch/l4/include/asm/arm/arch-ixp4xx
Y.SPATH += &linux_path/arch/l4/include/asm/mips
Y.SPATH += &linux_path/arch/l4/include/asm/driver
Y.SPATH += &linux_path/arch/l4/include/asm/i386
Y.SPATH += &linux_path/arch/l4/sys-arm
Y.SPATH += &linux_path/arch/l4/sys-arm/mach-sa1100
Y.SPATH += &linux_path/arch/l4/sys-arm/mach-ixp4xx
Y.SPATH += &linux_path/arch/l4/sys-arm/mach-pxa
Y.SPATH += &linux_path/arch/l4/lib
Y.SPATH += &linux_path/arch/l4/sys-mips

Y.SPATH += &linux_path/usr

Y.SPATH += &linux_path/ipc
Y.SPATH += &linux_path/block

Y.SPATH += &linux_path/virt
Y.SPATH += &linux_path/virt/kvm

Y.SPATH += &linux_path/fs
Y.SPATH += &linux_path/fs/exportfs
Y.SPATH += &linux_path/fs/cramfs
Y.SPATH += &linux_path/fs/afs
Y.SPATH += &linux_path/fs/btrfs
Y.SPATH += &linux_path/fs/ubifs
Y.SPATH += &linux_path/fs/cachefiles
Y.SPATH += &linux_path/fs/quota
Y.SPATH += &linux_path/fs/devpts
Y.SPATH += &linux_path/fs/ntfs
Y.SPATH += &linux_path/fs/nfsd
Y.SPATH += &linux_path/fs/logfs
Y.SPATH += &linux_path/fs/squashfs
Y.SPATH += &linux_path/fs/ceph
Y.SPATH += &linux_path/fs/gfs2
Y.SPATH += &linux_path/fs/sysfs
Y.SPATH += &linux_path/fs/9p
Y.SPATH += &linux_path/fs/jffs2
Y.SPATH += &linux_path/fs/yaffs2
Y.SPATH += &linux_path/fs/yaffs2/linux-tests
Y.SPATH += &linux_path/fs/yaffs2/linux-tests/CVS
Y.SPATH += &linux_path/fs/yaffs2/patches
Y.SPATH += &linux_path/fs/yaffs2/patches/CVS
Y.SPATH += &linux_path/fs/yaffs2/CVS
Y.SPATH += &linux_path/fs/yaffs2/utils
Y.SPATH += &linux_path/fs/yaffs2/utils/CVS
Y.SPATH += &linux_path/fs/yaffs2/direct
Y.SPATH += &linux_path/fs/yaffs2/direct/python
Y.SPATH += &linux_path/fs/yaffs2/direct/python/CVS
Y.SPATH += &linux_path/fs/yaffs2/direct/CVS
Y.SPATH += &linux_path/fs/yaffs2/direct/fsx_test
Y.SPATH += &linux_path/fs/yaffs2/direct/fsx_test/CVS
Y.SPATH += &linux_path/fs/yaffs2/direct/tests
Y.SPATH += &linux_path/fs/yaffs2/direct/tests/CVS
Y.SPATH += &linux_path/fs/yaffs2/mtdemul
Y.SPATH += &linux_path/fs/yaffs2/mtdemul/CVS
Y.SPATH += &linux_path/fs/yaffs2/documentation
Y.SPATH += &linux_path/fs/yaffs2/documentation/CVS
Y.SPATH += &linux_path/fs/configfs
Y.SPATH += &linux_path/fs/jfs
Y.SPATH += &linux_path/fs/exofs
Y.SPATH += &linux_path/fs/proc
Y.SPATH += &linux_path/fs/affs
Y.SPATH += &linux_path/fs/ext4
Y.SPATH += &linux_path/fs/hfs
Y.SPATH += &linux_path/fs/romfs
Y.SPATH += &linux_path/fs/udf
Y.SPATH += &linux_path/fs/cifs
Y.SPATH += &linux_path/fs/nilfs2
Y.SPATH += &linux_path/fs/ext2
Y.SPATH += &linux_path/fs/nfs_common
Y.SPATH += &linux_path/fs/fuse
Y.SPATH += &linux_path/fs/freevxfs
Y.SPATH += &linux_path/fs/bfs
Y.SPATH += &linux_path/fs/nfs
Y.SPATH += &linux_path/fs/ecryptfs
Y.SPATH += &linux_path/fs/ocfs2
Y.SPATH += &linux_path/fs/ocfs2/dlm
Y.SPATH += &linux_path/fs/ocfs2/cluster
Y.SPATH += &linux_path/fs/ocfs2/dlmfs
Y.SPATH += &linux_path/fs/dlm
Y.SPATH += &linux_path/fs/xfs
Y.SPATH += &linux_path/fs/xfs/quota
Y.SPATH += &linux_path/fs/xfs/linux-2Y.SPATH += &linux_path6
Y.SPATH += &linux_path/fs/xfs/support
Y.SPATH += &linux_path/fs/autofs4
Y.SPATH += &linux_path/fs/hpfs
Y.SPATH += &linux_path/fs/omfs
Y.SPATH += &linux_path/fs/ramfs
Y.SPATH += &linux_path/fs/fscache
Y.SPATH += &linux_path/fs/ncpfs
Y.SPATH += &linux_path/fs/openpromfs
Y.SPATH += &linux_path/fs/fat
Y.SPATH += &linux_path/fs/notify
Y.SPATH += &linux_path/fs/notify/inotify
Y.SPATH += &linux_path/fs/notify/fanotify
Y.SPATH += &linux_path/fs/notify/dnotify
Y.SPATH += &linux_path/fs/hppfs
Y.SPATH += &linux_path/fs/isofs
Y.SPATH += &linux_path/fs/hostfs
Y.SPATH += &linux_path/fs/debugfs
Y.SPATH += &linux_path/fs/jbd2
Y.SPATH += &linux_path/fs/hugetlbfs
Y.SPATH += &linux_path/fs/lockd
Y.SPATH += &linux_path/fs/nls
Y.SPATH += &linux_path/fs/qnx4
Y.SPATH += &linux_path/fs/jbd
Y.SPATH += &linux_path/fs/hfsplus
Y.SPATH += &linux_path/fs/minix
Y.SPATH += &linux_path/fs/adfs
Y.SPATH += &linux_path/fs/partitions
Y.SPATH += &linux_path/fs/reiserfs
Y.SPATH += &linux_path/fs/ext3
Y.SPATH += &linux_path/fs/coda
Y.SPATH += &linux_path/fs/sysv
Y.SPATH += &linux_path/fs/ufs
Y.SPATH += &linux_path/fs/efs
Y.SPATH += &linux_path/fs/befs
Y.SPATH += &linux_path/include
Y.SPATH += &linux_path/include/scsi
Y.SPATH += &linux_path/include/scsi/fc
Y.SPATH += &linux_path/include/trace
Y.SPATH += &linux_path/include/trace/events
Y.SPATH += &linux_path/include/pcmcia
Y.SPATH += &linux_path/include/crypto
Y.SPATH += &linux_path/include/crypto/internal
Y.SPATH += &linux_path/include/keys
Y.SPATH += &linux_path/include/video
Y.SPATH += &linux_path/include/acpi
Y.SPATH += &linux_path/include/acpi/platform
Y.SPATH += &linux_path/include/sound
Y.SPATH += &linux_path/include/xen
Y.SPATH += &linux_path/include/xen/interface
Y.SPATH += &linux_path/include/xen/interface/hvm
Y.SPATH += &linux_path/include/xen/interface/io
Y.SPATH += &linux_path/include/target
Y.SPATH += &linux_path/include/media
Y.SPATH += &linux_path/include/media/davinci
Y.SPATH += &linux_path/include/drm
Y.SPATH += &linux_path/include/drm/i2c
Y.SPATH += &linux_path/include/drm/ttm
Y.SPATH += &linux_path/include/rxrpc
Y.SPATH += &linux_path/include/linux
Y.SPATH += &linux_path/include/linux/wimax
Y.SPATH += &linux_path/include/linux/ssb
Y.SPATH += &linux_path/include/linux/can
Y.SPATH += &linux_path/include/linux/can/platform
Y.SPATH += &linux_path/include/linux/mmc
Y.SPATH += &linux_path/include/linux/nfsd
Y.SPATH += &linux_path/include/linux/netfilter_ipv6
Y.SPATH += &linux_path/include/linux/ceph
Y.SPATH += &linux_path/include/linux/spi
Y.SPATH += &linux_path/include/linux/i2c
Y.SPATH += &linux_path/include/linux/nfc
Y.SPATH += &linux_path/include/linux/raid
Y.SPATH += &linux_path/include/linux/netfilter_arp
Y.SPATH += &linux_path/include/linux/rtc
Y.SPATH += &linux_path/include/linux/netfilter_bridge
Y.SPATH += &linux_path/include/linux/regulator
Y.SPATH += &linux_path/include/linux/dvb
Y.SPATH += &linux_path/include/linux/power
Y.SPATH += &linux_path/include/linux/netfilter
Y.SPATH += &linux_path/include/linux/hdlc
Y.SPATH += &linux_path/include/linux/unaligned
Y.SPATH += &linux_path/include/linux/isdn
Y.SPATH += &linux_path/include/linux/amba
Y.SPATH += &linux_path/include/linux/mfd
Y.SPATH += &linux_path/include/linux/mfd/wm831x
Y.SPATH += &linux_path/include/linux/mfd/wm8350
Y.SPATH += &linux_path/include/linux/mfd/wm8994
Y.SPATH += &linux_path/include/linux/mfd/pcf50633
Y.SPATH += &linux_path/include/linux/decompress
Y.SPATH += &linux_path/include/linux/tc_ematch
Y.SPATH += &linux_path/include/linux/tc_act
Y.SPATH += &linux_path/include/linux/crush
Y.SPATH += &linux_path/include/linux/input
Y.SPATH += &linux_path/include/linux/caif
Y.SPATH += &linux_path/include/linux/uwb
Y.SPATH += &linux_path/include/linux/lockd
Y.SPATH += &linux_path/include/linux/usb
Y.SPATH += &linux_path/include/linux/mlx4
Y.SPATH += &linux_path/include/linux/netfilter_ipv4
Y.SPATH += &linux_path/include/linux/byteorder
Y.SPATH += &linux_path/include/linux/mtd
Y.SPATH += &linux_path/include/linux/sunrpc
Y.SPATH += &linux_path/include/net
Y.SPATH += &linux_path/include/net/9p
Y.SPATH += &linux_path/include/net/bluetooth
Y.SPATH += &linux_path/include/net/irda
Y.SPATH += &linux_path/include/net/iucv
Y.SPATH += &linux_path/include/net/sctp
Y.SPATH += &linux_path/include/net/netfilter
Y.SPATH += &linux_path/include/net/netfilter/ipv4
Y.SPATH += &linux_path/include/net/netfilter/ipv6
Y.SPATH += &linux_path/include/net/tc_act
Y.SPATH += &linux_path/include/net/caif
Y.SPATH += &linux_path/include/net/netns
Y.SPATH += &linux_path/include/net/phonet
Y.SPATH += &linux_path/include/asm-generic
Y.SPATH += &linux_path/include/asm-generic/bitops
Y.SPATH += &linux_path/include/rdma
Y.SPATH += &linux_path/include/mtd
Y.SPATH += &linux_path/include/math-emu

Y.SPATH += &linux_path/init