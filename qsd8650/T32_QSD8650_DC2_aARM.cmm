;****************************************************************************
;**           daisychain_mode2_scorpion.CMM                                **
;**           This script sets up scorpion JTAG scan for mode 2            **
;**           mode 1 = NAtive, ARM9 + Scorpion PJTAG + QDSP6               **
;**                                                                        **
;**           Changes:                                                     **
;**           09-14-07   KB - Moved entry down and added intercom info      **
;**           03-29-07   KBurke - designate slave session (to avoid sRST or **
;**                      tRST issues- only master controls these)           **
;**           03-07-07   First version KBurke                              **
;****************************************************************************
local &arg_name 
local &arg_node_num 
local &arg_port_num
local &arg_core_num
local &arg_use_directive
local &cmm_dir
local &core_startup
local &t32_tempdir

global &t32_intercom_port     // used to identify the current port ID being used
global &QC_cpu                // current CPU selected
global &QC_jtag_mode          // jtag mode (0 indicates non-daisychained)
global &QC_jtag_cfg           // for l4/amss script interfacing parallel indicates non-daisychain

ENTRY &arg_name &arg_node_num &arg_port_num &arg_core_num &arg_use_directive

;STOP    // used only for pedit debug

&t32_intercom_port=&arg_port_num

&cmm_dir=os.ppd()         ; directory where this script is running from
&core_startup="T32_DAP.cmm"

if (os.file("&cmm_dir\&core_startup"))
(
  do "&cmm_dir\&core_startup"            ; Call standard dap setup and then perform any required overrides
)
else
(
  print "&cmm_dir\&core_startup not found"
  enddo 1
)

;------------------------------------------------------------------------------
; perform daisychain specific overrides
;------------------------------------------------------------------------------

  ; select CPU and options
  SYSTEM.CPU SCORPION
  SYSTEM.MULTICORE DAPIRPOST 4.  // tell trace32 that there are 4 extra IR bits near TDI (ARM9)
  SYSTEM.MULTICORE DAPDRPOST 1.  // tell trace32 that there is 1 extra DR bit near TDI when this unit is in bypass
  SYSTEM.MULTICORE DAPIRPRE  7.  // tell trace32 that there are 7 extra IR bits near TDO (QDSP6)
  SYSTEM.MULTICORE DAPDRPRE  1.  // tell trace32 that there is 1 extra DR bit near TDO when this unit is in bypass
  ;SYSTEM.OPTION ENRESET OFF // 01/06/05 change to comment out due to EEMBC start failures

  system.jtagclock RTCK  // look for ARM's wacky return TCK
  SYSTEM.MULTICORE SLAVE ON // tell trace32 that this is a slave session so do not play with tRST and sRST


if (&arg_core_num=="")||(&arg_core_num=="CORE=1")
(
  if Analyzer()
  (
    etm.portmode 1/1
    ;etm.portmode continuous
    etm.portsize 16
    ;etm.contextid 32
    etm.datatrace address
    trace.autoinit.on
    trace.clock 1mhz
    etm.CYCLEACCURATE on
    etm.on
  )
)

; system.up

;------------------------------------------------------------------------------
; override any other settings that seem appropriate
;------------------------------------------------------------------------------

&t32_tempdir=os.ptd()             ; get the active T32 temp directory name 
cd &t32_tempdir                   ; change directory to the temp T32 directory as default 

printer.file &t32_tempdir\"&arg_name"_"&arg_node_num"_00.lst

&QC_cpu=CPU()
&QC_jtag_mode=2.             // daisychain mode 2 mARM+aARM+dsp
&QC_jtag_cfg="chain"         // non-daisychain mode


ENDDO 0









