;*****************************************************************************
;**           T32_QSD8650_DC1_ARM9.CMM                                      **
;**           This script sets up ARM9 JTAG scan for DaisyChain mode 1 (DC1)**
;**           mode 1 = NAtive, ARM9 + Scorpion PJTAG                        **
;**                                                                         **
;**           Changes:                                                      **
;**           09-14-07   KCB added amss globals                             **
;**           04-30-07   KCB make ARM9 non-slave port for sRST/tRST         **
;**           03-07-07   First version KBurke                               **
;*****************************************************************************

local &arg_name 
local &arg_node_num 
local &arg_port_num
local &arg_core_num
local &arg_use_directive
local &cmm_dir
local &core_startup
local &t32_tempdir

global &t32_intercom_port     // used to identify the current port ID being used
global &QC_cpu                // current CPU selected
global &QC_jtag_mode          // jtag mode (0 indicates non-daisychained)
global &QC_jtag_cfg           // for l4/amss script interfacing parallel indicates non-daisychain

ENTRY &arg_name &arg_node_num &arg_port_num &arg_core_num &arg_use_directive

&t32_intercom_port=&arg_port_num

&cmm_dir=os.ppd()                      ; directory where this script is running from
&core_startup="T32_ARM9.cmm"

if (os.file("&cmm_dir\&core_startup"))
(
  do "&cmm_dir\&core_startup"            ; Call standard dap setup and then perform any required overrides
)
else
(
  print "&cmm_dir\&core_startup" not found"
  enddo 1
)

;------------------------------------------------------------------------------
; perform daisychain specific overrides
;------------------------------------------------------------------------------
; select CPU and options
  SYSTEM.CPU ARM926EJ
  SYSTEM.MULTICORE IRPRE 4.  // tell trace32 that there are 4 extra IR bits near TDO (scoprion)
  SYSTEM.MULTICORE DRPRE 1.  // tell trace32 that there is 1 extra DR bits near TDO 

  system.jtagclock RTCK  // look for ARM's wacky return TCK
  SYSTEM.MULTICORE SLAVE OFF // tell trace32 that this is the master of the tRST and sRST signals

; system.up

;------------------------------------------------------------------------------
; override any other setting that seem appropriate
;------------------------------------------------------------------------------

&t32_tempdir=os.ptd()             ; get the active T32 temp directory name 
cd &t32_tempdir                   ; change directory to the temp T32 directory as default 

printer.file &t32_tempdir\"&arg_name"_"&arg_node_num"_00.lst

&QC_cpu=CPU()
&QC_jtag_mode=1.             // daisychain mode 1 mARM+aARM
&QC_jtag_cfg="chain"      // non-daisychain mode


ENDDO 0









