global &L4SRCROOT

&L4SRCROOT="../../platform/pistachio"
&L4ROOT="../../platform"
&L4AMSS="../.."

symbol.sourcepath.delete
  
; Set up the symbol paths to our source  

; L4 Kernel
  Symbol.Spath + "&L4SRCROOT/contrib/disas"
  Symbol.Spath + "&L4SRCROOT/kernel/include"
  Symbol.Spath + "&L4SRCROOT/kernel/include/api/v4"
  Symbol.Spath + "&L4SRCROOT/kernel/include/arch/arm"
  Symbol.Spath + "&L4SRCROOT/kernel/include/arch/arm/arm926"
  Symbol.Spath + "&L4SRCROOT/kernel/include/generic"
  Symbol.Spath + "&L4SRCROOT/kernel/include/glue/v4-arm"
  Symbol.Spath + "&L4SRCROOT/kernel/include/kdb"
  Symbol.Spath + "&L4SRCROOT/kernel/include/platform/surf"
  Symbol.Spath + "&L4SRCROOT/kernel/kdb/api/v4"
  Symbol.Spath + "&L4SRCROOT/kernel/kdb/arch/arm"
  Symbol.Spath + "&L4SRCROOT/kernel/kdb/generic"
  Symbol.Spath + "&L4SRCROOT/kernel/kdb/platform/surf"
  Symbol.Spath + "&L4SRCROOT/kernel/src/api/v4"
  Symbol.Spath + "&L4SRCROOT/kernel/src/arch/arm"
  Symbol.Spath + "&L4SRCROOT/kernel/src/generic"
  Symbol.Spath + "&L4SRCROOT/kernel/src/glue/v4-arm"
  Symbol.Spath + "&L4SRCROOT/kernel/src/platform/surf"
  Symbol.Spath + "&L4SRCROOT/tools/profiler/profiler"
  Symbol.Spath + "&L4SRCROOT/tools/profiler/profiler"

; L4 User apps
  Symbol.Spath + "&L4SRCROOT/user/apps/bench/pingpong"
  Symbol.Spath + "&L4SRCROOT/user/apps/grabmem"
  Symbol.Spath + "&L4SRCROOT/user/apps/l4test"
  Symbol.Spath + "&L4SRCROOT/user/apps/l4test/arm"
  Symbol.Spath + "&L4SRCROOT/user/contrib/elf-loader"
  Symbol.Spath + "&L4SRCROOT/user/contrib/elf-loader/common"
  Symbol.Spath + "&L4SRCROOT/user/contrib/elf-loader/common/openfirmware"
  Symbol.Spath + "&L4SRCROOT/user/contrib/elf-loader/platform/surf"
  Symbol.Spath + "&L4SRCROOT/user/lib/io"
  Symbol.Spath + "&L4SRCROOT/user/lib/l4"
  Symbol.Spath + "&L4SRCROOT/user/serv/sigma0"
  Symbol.Spath + "&L4SRCROOT/user/util/kickstart"
  Symbol.Spath + "&L4SRCROOT/user/util/piggybacker/common"
  Symbol.Spath + "&L4ROOT/example/timer/src"
  Symbol.Spath + "&L4ROOT/example/naming/src"
  Symbol.Spath + "&L4ROOT/example/qtest/src"

; Iguana apps
  Symbol.Spath + "&L4ROOT/iguana/timer/src"
  Symbol.Spath + "&L4ROOT/iguana/naming/src"
  Symbol.Spath + "&L4ROOT/iguana/serial_server/src"
  Symbol.Spath + "&L4ROOT/iguana/keypad_server/src"
  Symbol.Spath + "&L4ROOT/iguana/server/src"
  Symbol.Spath + "&L4ROOT/iguana/init/src"
  Symbol.Spath + "&L4ROOT/iguana/sigma0/src"
  Symbol.Spath + "&L4ROOT/iguana/framebuffer_server/src"
  Symbol.Spath + "&L4ROOT/iguana/rex/src"
  Symbol.Spath + "&L4ROOT/iguana/sdio_server/src"

  Symbol.Spath + "&L4ROOT/apps/efs2_server/src"
  Symbol.Spath + "&L4ROOT/apps/efs2_client/src"

; Iguana libs
  Symbol.Spath + "&L4ROOT/libs/aps/include"
  Symbol.Spath + "&L4ROOT/libs/aps/src"
  Symbol.Spath + "&L4ROOT/libs/bit_fl/include"
  Symbol.Spath + "&L4ROOT/libs/bit_fl/src"
  Symbol.Spath + "&L4ROOT/libs/c\crt/sys-baremetal/arch-arm"
  Symbol.Spath + "&L4ROOT/libs/c\crt/sys-iguana/arch-arm"
  Symbol.Spath + "&L4ROOT/libs/c\crt/sys-iguana_server/arch-arm"
  Symbol.Spath + "&L4ROOT/libs/c\crt/sys-l4_rootserver/arch-arm"
  Symbol.Spath + "&L4ROOT/libs/c\include"
  Symbol.Spath + "&L4ROOT/libs/c\src"
  Symbol.Spath + "&L4ROOT/libs/c\src/sys-iguana"
  Symbol.Spath + "&L4ROOT/libs/c\src/sys-iguana_server"
  Symbol.Spath + "&L4ROOT/libs/c\src/sys-l4_rootserver"
  Symbol.Spath + "&L4ROOT/libs/circular_buffer/include"
  Symbol.Spath + "&L4ROOT/libs/circular_buffer/src"
  Symbol.Spath + "&L4ROOT/libs/driver/include"
  Symbol.Spath + "&L4ROOT/libs/driver/include/driver"
  Symbol.Spath + "&L4ROOT/libs/driver/src/sys-iguana"
  Symbol.Spath + "&L4ROOT/libs/uart/include"
  Symbol.Spath + "&L4ROOT/libs/uart/src"
  Symbol.Spath + "&L4ROOT/libs/framebuffer/include"
  Symbol.Spath + "&L4ROOT/libs/framebuffer/src"
  Symbol.Spath + "&L4ROOT/libs/hash/include"
  Symbol.Spath + "&L4ROOT/libs/hash/src"
  Symbol.Spath + "&L4ROOT/libs/hwio/src"
  Symbol.Spath + "&L4ROOT/libs/hwio/include"
  Symbol.Spath + "&L4ROOT/libs/iguana/include"
  Symbol.Spath + "&L4ROOT/libs/iguana/src"
  Symbol.Spath + "&L4ROOT/libs/timer/include/timer"
  Symbol.Spath + "&L4ROOT/libs/timer/src"
  Symbol.Spath + "&L4ROOT/libs/naming/include/naming"
  Symbol.Spath + "&L4ROOT/libs/naming/src"
  Symbol.Spath + "&L4ROOT/libs/keypad/include"
  Symbol.Spath + "&L4ROOT/libs/keypad/src"
  Symbol.Spath + "&L4ROOT/libs/sdio/include"
  Symbol.Spath + "&L4ROOT/libs/sdio/src"
  Symbol.Spath + "&L4ROOT/libs/l4/include/l4"
  Symbol.Spath + "&L4ROOT/libs/l4/include/l4/arm"
  Symbol.Spath + "&L4ROOT/libs/l4/include/msm"
  Symbol.Spath + "&L4ROOT/libs/l4/src/arch-arm"
  Symbol.Spath + "&L4ROOT/libs/l4e/include/l4e"
  Symbol.Spath + "&L4ROOT/libs/l4e/src"
  Symbol.Spath + "&L4ROOT/libs/ll/include"
  Symbol.Spath + "&L4ROOT/libs/ll/src"
  Symbol.Spath + "&L4ROOT/libs/range_fl/include"
  Symbol.Spath + "&L4ROOT/libs/range_fl/src"
  Symbol.Spath + "&L4ROOT/libs/efs2/include"
  Symbol.Spath + "&L4ROOT/libs/efs2/src"
  Symbol.Spath + "&L4ROOT/libs/smms/include"
  Symbol.Spath + "&L4ROOT/libs/smms/src"
  Symbol.Spath + "&L4ROOT/libs/qids_smms/include"
  Symbol.Spath + "&L4ROOT/libs/qids_smms/src"
  Symbol.Spath + "&L4ROOT/libs/qids_rpc_infra/include"
  Symbol.Spath + "&L4ROOT/libs/qids_rpc_infra/src"
  Symbol.Spath + "&L4ROOT/libs/qids_rpc_infra_rex/include"
  Symbol.Spath + "&L4ROOT/libs/qids_rpc_infra_rex/src"
  Symbol.Spath + "&L4ROOT/libs/qids_rpc_stubs_client/include"
  Symbol.Spath + "&L4ROOT/libs/qids_rpc_stubs_client/src"
  Symbol.Spath + "&L4ROOT/libs/qids_rpc_stubs_server/include"
  Symbol.Spath + "&L4ROOT/libs/qids_rpc_stubs_server/src"
  Symbol.Spath + "&L4ROOT/libs/qids_rpc_stubs_common/include"
  Symbol.Spath + "&L4ROOT/libs/qids_rpc_stubs_common/src"
  Symbol.Spath + "&L4ROOT/libs/lk/include"
  Symbol.Spath + "&L4ROOT/libs/lk/src"
  Symbol.Spath + "&L4ROOT/libs/inh/include"
  Symbol.Spath + "&L4ROOT/libs/inh/src"
  Symbol.Spath + "&L4ROOT/libs/lsd/include"
  Symbol.Spath + "&L4ROOT/libs/lsd/src"
  Symbol.Spath + "&L4ROOT/libs/tramp_int/include"
  Symbol.Spath + "&L4ROOT/libs/tramp_int/src"

; IDL stuff
  Symbol.Spath + "&L4ROOT/tools/sw/include/idl4/api/v4"
  Symbol.Spath + "&L4ROOT/tools/sw/include/idl4/glue/v4-generic"

; Iguana auto generated files
  Symbol.Spath + "&L4ROOT/build/iguana/libs/iguana/include/interfaces"
  Symbol.Spath + "&L4ROOT/build/iguana/libs/keypad/include/interfaces"
  Symbol.Spath + "&L4ROOT/build/iguana/libs/timer/include/interfaces"
  Symbol.Spath + "&L4ROOT/build/iguana/libs/naming/include/interfaces"

; Linux files
  Symbol.Spath + "&L4ROOT/wombat/arch/l4/boot"
  Symbol.Spath + "&L4ROOT/wombat/arch/l4/kernel"
  Symbol.Spath + "&L4ROOT/wombat/arch/l4/include"
  Symbol.Spath + "&L4ROOT/wombat/arch/l4/kernel"
  Symbol.Spath + "&L4ROOT/wombat/arch/l4/lib"
  Symbol.Spath + "&L4ROOT/wombat/arch/l4/mm"
  Symbol.Spath + "&L4ROOT/wombat/arch/l4/sys-arm"
  Symbol.Spath + "&L4ROOT/wombat/crypto"
  Symbol.Spath + "&L4ROOT/wombat/drivers/qcom/framebuffer"
  Symbol.Spath + "&L4ROOT/wombat/drivers/qcom/inh"
  Symbol.Spath + "&L4ROOT/wombat/drivers/qcom/keypad"
  Symbol.Spath + "&L4ROOT/wombat/drivers/qcom/ms"
  Symbol.Spath + "&L4ROOT/wombat/fs"
  Symbol.Spath + "&L4ROOT/wombat/init"
  Symbol.Spath + "&L4ROOT/wombat/ipc"
  Symbol.Spath + "&L4ROOT/wombat/kernel"
  Symbol.Spath + "&L4ROOT/wombat/lib"
  Symbol.Spath + "&L4ROOT/wombat/mm"
  Symbol.Spath + "&L4ROOT/wombat/net"
  Symbol.Spath + "&L4ROOT/wombat/security"
; need to add more...

; AMSS files
  Symbol.Spath + "&L4AMSS/1x/cp"
  Symbol.Spath + "&L4AMSS/1x/mux"
  Symbol.Spath + "&L4AMSS/1x/srch/common"
  Symbol.Spath + "&L4AMSS/1x/srch/gps"
  Symbol.Spath + "&L4AMSS/1x/srch/idle"
  Symbol.Spath + "&L4AMSS/1x/srch/init"
  Symbol.Spath + "&L4AMSS/1x/srch/traffic"
  Symbol.Spath + "&L4AMSS/boot_loader"
  Symbol.Spath + "&L4AMSS/build/cust"
  Symbol.Spath + "&L4AMSS/build/ms"

  Symbol.Spath + "&L4AMSS/drivers/adc"
  Symbol.Spath + "&L4AMSS/drivers/adie"
  Symbol.Spath + "&L4AMSS/drivers/atmr"
  Symbol.Spath + "&L4AMSS/drivers/bio"
  Symbol.Spath + "&L4AMSS/drivers/boot"
  Symbol.Spath + "&L4AMSS/drivers/camif"
  Symbol.Spath + "&L4AMSS/drivers/chg"
  Symbol.Spath + "&L4AMSS/drivers/clk"
  Symbol.Spath + "&L4AMSS/drivers/dec"
  Symbol.Spath + "&L4AMSS/drivers/dfm"
  Symbol.Spath + "&L4AMSS/drivers/drvLib"
  Symbol.Spath + "&L4AMSS/drivers/enc"
  Symbol.Spath + "&L4AMSS/drivers/flash"
  Symbol.Spath + "&L4AMSS/drivers/grp"
  Symbol.Spath + "&L4AMSS/drivers/hw"
  Symbol.Spath + "&L4AMSS/drivers/i2c"
  Symbol.Spath + "&L4AMSS/drivers/kpd"
  Symbol.Spath + "&L4AMSS/drivers/lcd"
  Symbol.Spath + "&L4AMSS/drivers/mddi"
  Symbol.Spath + "&L4AMSS/drivers/mdp"
  Symbol.Spath + "&L4AMSS/drivers/mmc"
  Symbol.Spath + "&L4AMSS/drivers/pm"
  Symbol.Spath + "&L4AMSS/drivers/qgl"
  Symbol.Spath + "&L4AMSS/drivers/rf"
  Symbol.Spath + "&L4AMSS/drivers/sbi"
  Symbol.Spath + "&L4AMSS/drivers/sdac"
  Symbol.Spath + "&L4AMSS/drivers/sdcc"
  Symbol.Spath + "&L4AMSS/drivers/sio"
  Symbol.Spath + "&L4AMSS/drivers/therm"
  Symbol.Spath + "&L4AMSS/drivers/tlmm"
  Symbol.Spath + "&L4AMSS/drivers/tramp"
  Symbol.Spath + "&L4AMSS/drivers/usb"
  Symbol.Spath + "&L4AMSS/drivers/vbatt"

  Symbol.Spath + "&L4AMSS/services/adsp"
  Symbol.Spath + "&L4AMSS/services/ansic"
  Symbol.Spath + "&L4AMSS/services/audfmt"
  Symbol.Spath + "&L4AMSS/services/avs"
  Symbol.Spath + "&L4AMSS/services/bt"
  Symbol.Spath + "&L4AMSS/services/camcorder"
  Symbol.Spath + "&L4AMSS/services/camera"
  Symbol.Spath + "&L4AMSS/services/cm"
  Symbol.Spath + "&L4AMSS/services/cmx"
  Symbol.Spath + "&L4AMSS/services/diag"
  Symbol.Spath + "&L4AMSS/services/dload"
  Symbol.Spath + "&L4AMSS/services/dsm"
  Symbol.Spath + "&L4AMSS/services/efs"
  Symbol.Spath + "&L4AMSS/services/egl"
  Symbol.Spath + "&L4AMSS/services/fs"
  Symbol.Spath + "&L4AMSS/services/ftm"
  Symbol.Spath + "&L4AMSS/services/gles"
  Symbol.Spath + "&L4AMSS/services/gps"
  Symbol.Spath + "&L4AMSS/services/graph"
  Symbol.Spath + "&L4AMSS/services/gstk"
  Symbol.Spath + "&L4AMSS/services/hs"
  Symbol.Spath + "&L4AMSS/services/mdsp"
  Symbol.Spath + "&L4AMSS/services/mdspsvc"
  Symbol.Spath + "&L4AMSS/services/mmgsdi"
  Symbol.Spath + "&L4AMSS/services/mmoc"
  Symbol.Spath + "&L4AMSS/services/mvs"
  Symbol.Spath + "&L4AMSS/services/nv"
  Symbol.Spath + "&L4AMSS/services/pe"
  Symbol.Spath + "&L4AMSS/services/qdsp"
  Symbol.Spath + "&L4AMSS/services/qids_rpc"
  Symbol.Spath + "&L4AMSS/services/qtv"
  Symbol.Spath + "&L4AMSS/services/rex"
  Symbol.Spath + "&L4AMSS/services/rte"
  Symbol.Spath + "&L4AMSS/services/sam"
  Symbol.Spath + "&L4AMSS/services/sd"
  Symbol.Spath + "&L4AMSS/services/sfat"
  Symbol.Spath + "&L4AMSS/services/sleep"
  Symbol.Spath + "&L4AMSS/services/task"
  Symbol.Spath + "&L4AMSS/services/time"
  Symbol.Spath + "&L4AMSS/services/tmc"
  Symbol.Spath + "&L4AMSS/services/transcoder"
  Symbol.Spath + "&L4AMSS/services/uim"
  Symbol.Spath + "&L4AMSS/services/utils"
  Symbol.Spath + "&L4AMSS/services/vdb"
  Symbol.Spath + "&L4AMSS/services/videofmt"
  Symbol.Spath + "&L4AMSS/services/vm"
  Symbol.Spath + "&L4AMSS/services/vr"
  Symbol.Spath + "&L4AMSS/services/vre"
  Symbol.Spath + "&L4AMSS/services/vs"
  Symbol.Spath + "&L4AMSS/services/wms"
  Symbol.Spath + "&L4AMSS/services/xmllib"

  Symbol.Spath + "&L4AMSS/test/ftm_hwtc"
  Symbol.Spath + "&L4AMSS/tools/jflash"
  Symbol.Spath + "&L4AMSS/tools/jnand"

